## boards/st/module_car/Kconfig.module_car
```kconfig
# Copyright (c) 2019 SEAL AG
# SPDX-License-Identifier: Apache-2.0

config BOARD_MODULE_CAR
	select SOC_STM32G031XX
```

## tools/west.yml
```yaml
manifest:
  version: "0.12"

  defaults:
    remote: zephyrproject

  remotes:
    - name: zephyrproject
      url-base: https://github.com/zephyrproject-rtos

  projects:
    - name: zephyr
      repo-path: zephyr.git
      path: zephyr
      remote: zephyrproject
      revision: v3.7.1
      clone-depth: 1
      import:
        name-allowlist:
          - cmsis
          - hal_st
          - hal_stm32

  self:
    path: zephyr
```
